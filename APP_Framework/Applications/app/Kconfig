## APP_Framework/Applications/app/Kconfig
```kconfig
menu "app"

    menuconfig APPLICATION_APP
        bool "Using app"
        default y

endmenu
```

## APP_Framework/Applications/mutex/Kconfig
```kconfig
menu "mutex"

    menuconfig APPLICATION_MUTEX
        bool "Using mutex"
        default y

endmenu
```

## APP_Framework/Framework/knowing/kpu/k210_yolov2_detect_procedure/Kconfig
```kconfig
menuconfig USING_K210_YOLOV2_DETECT
    bool "k210 yolov2 detect procedure"
	depends on USING_KPU_PROCESSING
    default y

config KPU_DEV_DRIVER
    string "Set kpu dev path"
    default "/dev/kpu_dev"

config CAMERA_DEV_DRIVER
    string "Set camera dev path for kpu"
    default "/dev/camera_dev"

config KPU_LCD_DEV_DRIVER
    string "Set lcd dev path for kpu"
    default "/dev/lcd_dev"
```

## APP_Framework/Framework/sensor/infrared/Kconfig
```kconfig
config SENSOR_HCSR501_MOTION
    bool "HC-SR501 Motion Sensor"
    default n
    help
      Enable support for HC-SR501 PIR motion sensor

if SENSOR_HCSR501_MOTION
    config SENSOR_DEVICE_HCSR501
        string "Sensor name"
        default "hcsr501"
    
    config SENSOR_QUANTITY_HCSR501_MOTION
        string "Quantity name"
        default "motion_detection"

    choice
        prompt "Target Platform"
        default HCSR501_PLATFORM_XIZI
    
    config HCSR501_PLATFORM_XIZI
        bool "XiZi"
    
    config HCSR501_PLATFORM_NUTTX
        bool "NuttX"
    
    config HCSR501_PLATFORM_RTTHREAD
        bool "RT-Thread"
    endchoice

    if HCSR501_PLATFORM_XIZI
        config SENSOR_DEVICE_HCSR501_GPIO_DEV
            string "GPIO device"
            default "/dev/pin_dev"
        
        config SENSOR_DEVICE_HCSR501_GPIO_PIN
            int "GPIO pin"
            default 35
        
        config SENSOR_DEVICE_HCSR501_IRQ_MODE
            int "IRQ mode"
            default 2
    endif

    if HCSR501_PLATFORM_NUTTX
        config SENSOR_DEVICE_HCSR501_GPIO_DEV
            string "GPIO device"
            default "/dev/pin_dev"
        
        config SENSOR_DEVICE_HCSR501_GPIO_PIN
            int "GPIO pin"
            default 35
        
        config SENSOR_DEVICE_HCSR501_IRQ_MODE
            int "IRQ mode"
            default 2
    endif

    if HCSR501_PLATFORM_RTTHREAD
        config SENSOR_DEVICE_HCSR501_GPIO_DEV
            string "GPIO device"
            default "/dev/pin_dev"
        
        config SENSOR_DEVICE_HCSR501_GPIO_PIN
            int "GPIO pin"
            default 35
        
        config SENSOR_DEVICE_HCSR501_IRQ_MODE
            int "IRQ mode"
            default 2
    endif
endif
```

## APP_Framework/Framework/sensor/light/Kconfig
```kconfig
config SENSOR_BH1750_LIGHT
        bool "Using BH1750 for light"
        default y

        if SENSOR_BH1750_LIGHT
                config SENSOR_DEVICE_BH1750
                        string "BH1750 sensor name"
                        default "bh1750_1"
                
                config SENSOR_QUANTITY_BH1750_LIGHT
                        string "BH1750 quantity name"
                        default "light_1"
                
                if ADD_XIZI_FEATURES
                        config SENSOR_DEVICE_BH1750_DEV
                                string "BH1750 device name"
                                default "/dev/i2c1_dev0"
                                
                        config SENSOR_DEVICE_BH1750_I2C_ADDR
                                hex "BH1750 device i2c address"
                                default 0x23
                endif

        endif
```

## APP_Framework/Framework/sensor/temperature/Kconfig
```kconfig
config SENSOR_HS300X_TEMPERATURE
        bool "Using HS300x for temperature"
        default n

        if SENSOR_HS300X_TEMPERATURE
                config SENSOR_DEVICE_HS300X
                        string "HS300x sensor name"
                        default "hs300x_1"
                
                config SENSOR_QUANTITY_HS300X_TEMPERATURE
                        string "HS300x quantity name"
                        default "temperature_1"
                
                if ADD_XIZI_FEATURES
                        config SENSOR_DEVICE_HS300X_DEV
                                string "HS300x device name"
                                default "/dev/i2c1_dev0"
                                
                        config SENSOR_DEVICE_HS300X_I2C_ADDR
                                hex "HS300x device i2c address"
                                default 0x44
                endif

                if ADD_NUTTX_FEATURES
                        config SENSOR_DEVICE_HS300X_DEV
                                string "HS300x device name"
                                default "/dev/i2c1_dev0"
                        
                        config SENSOR_DEVICE_HS300X_I2C_ADDR
                                hex "HS300x device i2c address"
                                default 0x44

                endif

                if ADD_RTTHREAD_FEATURES
                        config SENSOR_DEVICE_HS300X_DEV
                                string "HS300x device name"
                                default "/dev/i2c1"
                       config SENSOR_DEVICE_HS300X_I2C_ADDR
                                hex "HS300x device i2c address"
                                default 0x44

                endif
        endif


config SENSOR_DHT22_TEMPERATURE
        bool "Using DHT22 for temperature"
        default n

        if SENSOR_DHT22_TEMPERATURE
                config SENSOR_DEVICE_DHT22
                        string "DHT22 sensor name"
                        default "dht22"
                
                config SENSOR_QUANTITY_DHT22_TEMPERATURE
                        string "DHT22 quantity name"
                        default "temperature_2"
                
                if ADD_XIZI_FEATURES
                        config SENSOR_DEVICE_DHT22_DEV
                                string "DHT22 device name"
                                default "/dev/pin_dev"

                                
                        config SENSOR_DEVICE_DHT22_GPIO_PIN
                                int "GPIO pin"
                                default 35

                endif

                if ADD_NUTTX_FEATURES
                        config SENSOR_DEVICE_DHT22_DEV
                                string "DHT22 device name"
                                default "/dev/pin_dev"

                        config SENSOR_DEVICE_DHT22_GPIO_PIN
                                int "GPIO pin"
                                default 35

                endif

                if ADD_RTTHREAD_FEATURES
                        config SENSOR_DEVICE_DHT22_DEV
                                string "DHT22 device name"
                                default "/dev/pin_dev"

                        config SENSOR_DEVICE_DHT22_GPIO_PIN
                                int "GPIO pin"
                                default 35

                endif
        endif

config SENSOR_SHT20_TEMPERATURE
        bool "Using SHT20 for temperature"
        default n

        if SENSOR_SHT20_TEMPERATURE
                config SENSOR_DEVICE_SHT20
                        string "SHT20 sensor name"
                        default "sht20_1"
                
                config SENSOR_QUANTITY_SHT20_TEMPERATURE
                        string "sht20 quantity name"
                        default "temperature_1"
                
                if ADD_XIZI_FEATURES
                        config SENSOR_DEVICE_SHT20_DEV
                                string "SHT20 device name"
                                default "/dev/i2c1_dev0"
                                
                        config SENSOR_DEVICE_SHT20_I2C_ADDR
                                hex "SHT20 device i2c address"
                                default 0x40
                endif

                if ADD_NUTTX_FEATURES
                        config SENSOR_DEVICE_SHT20_DEV
                                string "SHT20 device name"
                                default "/dev/i2c1_dev0"
                        
                        config SENSOR_DEVICE_SHT20_I2C_ADDR
                                hex "SHT20 device i2c address"
                                default 0x40

                endif

                if ADD_RTTHREAD_FEATURES
                        config SENSOR_DEVICE_SHT20_DEV
                                string "SHT20 device name"
                                default "/dev/i2c1"
                       config SENSOR_DEVICE_SHT20_I2C_ADDR
                                hex "SHT20 device i2c address"
                                default 0x40

                endif
        endif
```
